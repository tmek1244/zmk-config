#include "loss-layouts.dtsi"

/ {
    chosen {
        zmk,kscan = &mock_kscan;
    };

    // The dongle has no keys of its own, all key events come from the halves.
    mock_kscan: mock_kscan_0 {
        compatible = "zmk,kscan-mock";
        columns = <0>;
        rows = <0>;
        events = <0>;
    };
};
