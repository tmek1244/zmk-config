## boards/loss/Kconfig.defconfig
```kconfig
if SHIELD_LOSS_LEFT

config ZMK_KEYBOARD_NAME
    default "IsThisLoss"

config ZMK_SPLIT_ROLE_CENTRAL
    default y

endif

if SHIELD_LOSS_LEFT || SHIELD_LOSS_RIGHT

config ZMK_SPLIT
    default y

endif
```

## config/boards/shields/loss/Kconfig.shield
```kconfig
config SHIELD_LOSS_LEFT
    def_bool $(shields_list_contains,loss_left)

config SHIELD_LOSS_RIGHT
    def_bool $(shields_list_contains,loss_right)
```
