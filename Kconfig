## Kconfig
```kconfig
config LOSS_BATTERY_LED
    bool "Blink the controller's LED when the battery is low"
    depends on ZMK_BATTERY_REPORTING
    depends on $(dt_nodelabel_enabled,blue_led)
    select GPIO

if LOSS_BATTERY_LED

config LOSS_BATTERY_LED_THRESHOLD
    int "Blink when the battery is at or below this percentage"
    range 1 100
    default 15

config LOSS_BATTERY_LED_INTERVAL_MS
    int "Time between blinks, in milliseconds"
    default 5000

endif
```
